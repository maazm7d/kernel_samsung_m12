## arch/arm64/configs/exynos850-eng_defconfig
```kconfig
#
# SLSI Debugging
#
CONFIG_CMUCAL_DEBUG=y
CONFIG_EXYNOS_EHLD=y
# CONFIG_DEBUG_SNAPSHOT_USER_MODE is not set

#
# Kernel Performance Events and Counters
#
CONFIG_SLUB_DEBUG=y
CONFIG_CGROUP_DEBUG=y

#
# printk and dmesg options
#
CONFIG_DYNAMIC_DEBUG=y

#
# Memory Debugging
#
CONFIG_DEBUG_PAGEALLOC=y
CONFIG_DEBUG_PAGEALLOC_ENABLE_DEFAULT=y
CONFIG_PAGE_POISONING=y
CONFIG_DEBUG_RODATA_TEST=y
CONFIG_DEBUG_OBJECTS=y
CONFIG_DEBUG_OBJECTS_FREE=y
CONFIG_DEBUG_OBJECTS_TIMERS=y
CONFIG_DEBUG_OBJECTS_WORK=y
CONFIG_DEBUG_OBJECTS_RCU_HEAD=y
CONFIG_DEBUG_OBJECTS_PERCPU_COUNTER=y
CONFIG_DEBUG_PER_CPU_MAPS=y
CONFIG_SLUB_DEBUG_ON=y
CONFIG_DEBUG_KMEMLEAK=y
CONFIG_DEBUG_KMEMLEAK_EARLY_LOG_SIZE=8192
CONFIG_DEBUG_KMEMLEAK_DEFAULT_OFF=y
CONFIG_DEBUG_STACK_USAGE=y
CONFIG_DEBUG_MEMORY_INIT=y
CONFIG_PTRACK_DEBUG=y
CONFIG_CMA_DEBUGFS=y

#
# Debug Lockups and Hangs
#
CONFIG_SCHED_STACK_END_CHECK=y
CONFIG_TIMER_STATS=y
CONFIG_DEBUG_PREEMPT=y

#
# Lock Debugging (spinlocks, mutexes, etc...)
#
CONFIG_DEBUG_RT_MUTEXES=y
CONFIG_DEBUG_SPINLOCK=y
CONFIG_DEBUG_MUTEXES=y
# CONFIG_DEBUG_LOCK_ALLOC is not set
# CONFIG_PROVE_LOCKING is not set
CONFIG_DEBUG_LIST=y
CONFIG_DEBUG_PI_LIST=y
CONFIG_DEBUG_SG=y
CONFIG_DEBUG_PREEMPT=y

CONFIG_IS_DDK_DATA_LOAD=n

#
# Battery driver
#
CONFIG_ENG_BATTERY_CONCEPT=y

#
# SENSORHUB Debug
#
CONFIG_SSP_ENG_DEBUG=y
CONFIG_SHUB_DEBUG=y

#
# GPIO Debugging
#
CONFIG_SEC_GPIO_DVS=y

# USB Eye Pattern
CONFIG_USB_EHSET_TEST_FIXTURE=y

# SDP KeyManagement Test for MDFPP evaluation
CONFIG_SDP_KEY_DUMP=y

CONFIG_DEBUG_FS=y

# UH
# CONFIG_RKP_FIMC_CHECK is not set
# CONFIG_KDP is not set

CONFIG_EXYNOS_BCM_DBG=y
CONFIG_EXYNOS_BCM_DBG_GNR=y

#
# WLBT eng mode
#
CONFIG_SCSC_WLAN_DEBUG=y
CONFIG_SCSC_DEBUG=y
CONFIG_SCSC_DEBUG_COMPATIBILITY=y
CONFIG_SCSC_DBG_SAMPLER=y

#
# DO NOT REMOVE THE LAST BLANK LINE
#
```

## arch/arm64/configs/exynos850-userdebug_defconfig
```kconfig
# UH
# CONFIG_RKP_FIMC_CHECK is not set
# CONFIG_KDP is not set

CONFIG_IS_DDK_DATA_LOAD=n

CONFIG_SEC_GPIO_DVS=y

# SDP KeyManagement Test for MDFPP evaluation
CONFIG_SDP_KEY_DUMP=y

CONFIG_DEBUG_FS=y

#
# DO NOT REMOVE THE LAST BLANK LINE
#
```

## arch/arm64/configs/universal3830_defconfig
```kconfig
#
# UNIVERSAL3830 board specific configuration
#
CONFIG_REGULATOR_S2MPB03=y
CONFIG_MODEM_IF_QOS=y
CONFIG_EXYNOS_ENABLE_HDCP2=y
CONFIG_SCSC_WLBT_CONFIG_PLATFORM="nacho_s612_a31_univ"
CONFIG_SND_SOC_SAMSUNG_EXYNOS3830_SOUND=y
CONFIG_SND_SOC_AUD3004X=y
CONFIG_SND_SOC_AUD3004X_5PIN=y
CONFIG_SND_SOC_AUD3004X_6PIN=n
CONFIG_SND_SOC_AUD3004X_EXT_ANT=y
CONFIG_SND_SOC_SMA1303=y
```

## arch/arm64/configs/universal3830_r_launching_defconfig
```kconfig
#
# UNIVERSAL3830 board specific configuration
#
CONFIG_REGULATOR_S2MPB03=y
CONFIG_MODEM_IF_QOS=y
CONFIG_EXYNOS_ENABLE_HDCP2=y
CONFIG_SCSC_WLBT_CONFIG_PLATFORM="nacho_s612_a31_univ"
CONFIG_SND_SOC_SAMSUNG_EXYNOS3830_SOUND=y
CONFIG_SND_SOC_AUD3004X=y
CONFIG_SND_SOC_AUD3004X_5PIN=y
CONFIG_SND_SOC_AUD3004X_6PIN=n
CONFIG_SND_SOC_AUD3004X_EXT_ANT=y
CONFIG_SND_SOC_SMA1303=y
CONFIG_EXYNOS_PM_DOMAIN_DEBUG=y
CONFIG_ANDROID_BINDERFS=y
CONFIG_BPF_JIT=y
CONFIG_BPF_JIT_ALWAYS_ON=y
CONFIG_DM_SNAPSHOT=y
CONFIG_DUMMY=y
CONFIG_FS_VERITY=y
CONFIG_FS_VERITY_BUILTIN_SIGNATURES=y
# CONFIG_FW_CACHE is not set
CONFIG_IKHEADERS=y
CONFIG_STATIC_USERMODEHELPER=y
CONFIG_STATIC_USERMODEHELPER_PATH=""
CONFIG_VETH=y
CONFIG_ARM64_SW_TTBR0_PAN=y
CONFIG_EXT4_FS_POSIX_ACL=y
CONFIG_UNICODE=y
CONFIG_SOC_EXYNOS3830_ANDROID_VERSION_R=y
```

## arch/arm64/configs/universal9630_q_launching_defconfig
```kconfig
CONFIG_PSI=y
# CONFIG_ZONE_DMA32 is not set
CONFIG_PCI=y
CONFIG_PCIE_DW_PLAT_HOST=y
# CONFIG_CAVIUM_ERRATUM_22375 is not set
# CONFIG_CAVIUM_ERRATUM_23154 is not set
# CONFIG_CAVIUM_ERRATUM_27456 is not set
# CONFIG_CAVIUM_ERRATUM_30115 is not set
# CONFIG_QCOM_FALKOR_ERRATUM_1003 is not set
# CONFIG_QCOM_FALKOR_ERRATUM_1009 is not set
# CONFIG_QCOM_QDF2400_ERRATUM_0065 is not set
CONFIG_CMDLINE="androidboot.selinux=enforcing androidboot.debug_level=0x4948 corememsize=8G"
CONFIG_CMDLINE_EXTEND=y
CONFIG_PM_AUTOSLEEP=y
CONFIG_ENERGY_MODEL=y
CONFIG_ARM64_EXYNOS_MOCE=y
# CONFIG_EXYNOS_PSTATE_HAFM is not set
CONFIG_CMA_DEBUGFS=y
CONFIG_SND_SOC_SAMSUNG_EXYNOS9630_SOUND=y
CONFIG_SND_SOC_TAS2562=y
CONFIG_SEC_SND_ADAPTATION=y
CONFIG_XFRM_INTERFACE=y
CONFIG_XFRM_STATISTICS=y
# CONFIG_INET_XFRM_MODE_BEET is not set
CONFIG_NETFILTER_XT_TARGET_CT=y
CONFIG_NETFILTER_XT_MATCH_OWNER=y
CONFIG_NET_SCH_NETEM=y
CONFIG_NET_CLS_BPF=y
CONFIG_EXTRA_FIRMWARE="npu/NPU.bin"
CONFIG_EXTRA_FIRMWARE_DIR="./firmware"
CONFIG_BLK_DEV_LOOP_MIN_COUNT=16
CONFIG_VBUS_NOTIFIER=y
CONFIG_USE_SAFEOUT=y
CONFIG_DM_BOW=y
CONFIG_DM_DEFAULT_KEY=y
# CONFIG_HWMON is not set
CONFIG_FB_MODE_HELPERS=y
CONFIG_USB_SUPPORT=y
CONFIG_USB=y
CONFIG_ANDROID_SWITCH=y
CONFIG_EXYNOS_IOMMU=y
CONFIG_CAL_IF=y
CONFIG_CMUCAL_DEBUG=y
CONFIG_CMUCAL_QCH_IGNORE_SUPPORT=y
CONFIG_EXYNOS_SCI=y
# CONFIG_EXYNOS_BCM_DBG is not set
CONFIG_FLEXPMU=y
CONFIG_SHUB_PMUCAL=y
# CONFIG_EXYNOS_SSP is not set
# CONFIG_EXYNOS_CPU_PERF is not set
CONFIG_EXYNOS_ENABLE_HDCP2=y
# CONFIG_EXYNOS_PMU is not set
# CONFIG_EXYNOS_ALT_DVFS is not set
CONFIG_PHY_EXYNOS_MIPI=y
CONFIG_SWITCH=y
CONFIG_OVERLAY_FS=y
CONFIG_CRYPTO_DISKCIPHER_DEBUG=y
CONFIG_EXYNOS_FMP_FIPS=y
CONFIG_DEBUG_VM=y
CONFIG_DEBUG_VM_PGFLAGS=y
CONFIG_PANIC_ON_OOPS=y
# CONFIG_EXYNOS_OCP is not set
CONFIG_SYNC_FILE=y
CONFIG_USB_RTL8152=y
# CONFIG_NVME_TARGET is not set
# CONFIG_USB_CHIPIDEA is not set
# CONFIG_USB_GADGET_DEBUG is not set
# CONFIG_USB_GADGET_DEBUG_FILES is not set
# CONFIG_USB_GADGET_DEBUG_FS is not set
CONFIG_USB_GADGET_VBUS_DRAW=2
CONFIG_USB_GADGET_STORAGE_NUM_BUFFERS=2
# CONFIG_USB_OLD_CONFIGFS is not set
CONFIG_USB_ANDROID_SAMSUNG_COMPOSITE=y

#
# USB Peripheral Controller
#
# CONFIG_USB_FOTG210_UDC is not set
# CONFIG_USB_GR_UDC is not set
# CONFIG_USB_R8A66597 is not set
# CONFIG_USB_PXA27X is not set
# CONFIG_USB_MV_UDC is not set
# CONFIG_USB_MV_U3D is not set
# CONFIG_USB_SNP_UDC_PLAT is not set
# CONFIG_USB_M66592 is not set
# CONFIG_USB_BDC_UDC is not set
# CONFIG_USB_AMD5536UDC is not set
# CONFIG_USB_NET2272 is not set
# CONFIG_USB_NET2280 is not set
# CONFIG_USB_GOKU is not set
# CONFIG_USB_EG20T is not set
# CONFIG_USB_GADGET_XILINX is not set
# CONFIG_USB_DUMMY_HCD is not set
CONFIG_USB_LIBCOMPOSITE=y
CONFIG_USB_F_FS=y
CONFIG_USB_F_MIDI=y
CONFIG_USB_F_AUDIO_SRC=y
CONFIG_USB_F_ACC=y
CONFIG_USB_CONFIGFS=y
CONFIG_USB_CONFIGFS_UEVENT=y
# CONFIG_USB_CONFIGFS_SERIAL is not set
# CONFIG_USB_CONFIGFS_ACM is not set
# CONFIG_USB_CONFIGFS_OBEX is not set
# CONFIG_USB_CONFIGFS_NCM is not set
# CONFIG_USB_CONFIGFS_ECM is not set
# CONFIG_USB_CONFIGFS_ECM_SUBSET is not set
# CONFIG_USB_CONFIGFS_RNDIS is not set
# CONFIG_USB_CONFIGFS_EEM is not set
# CONFIG_USB_CONFIGFS_MASS_STORAGE is not set
# CONFIG_USB_CONFIGFS_F_LB_SS is not set
# CONFIG_USB_CONFIGFS_F_ADB is not set
# CONFIG_USB_CONFIGFS_F_SIMMIAN is not set
# CONFIG_USB_CONFIGFS_F_UAC1 is not set
# CONFIG_USB_CONFIGFS_F_UAC1_LEGACY is not set
# CONFIG_USB_CONFIGFS_F_UAC2 is not set
# CONFIG_USB_CONFIGFS_F_HID is not set
# CONFIG_USB_CONFIGFS_F_UVC is not set
# CONFIG_USB_CONFIGFS_F_PRINTER is not set
# CONFIG_OCFS2_FS is not set
CONFIG_CONFIGFS_FS=y
# CONFIG_DLM is not set
CONFIG_TOUCHSCREEN_MELFAS_MSS100=y
CONFIG_MODEM_IF_QOS=y
CONFIG_CPIF_TP_MONITOR=y
CONFIG_SND_SOC_AUD3003X=y
CONFIG_SND_SOC_AUD3003X_5PIN=y
CONFIG_SND_SOC_AUD3003X_6PIN=n
```

## drivers/staging/rtl8188eus/Kconfig
```kconfig
config RTL8188EUS
	tristate "Realtek 8188E USB WiFi"
	depends on USB
    default y
	---help---
	  Help message of RTL8188EU
```
